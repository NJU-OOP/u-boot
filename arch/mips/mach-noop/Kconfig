## arch/mips/mach-noop/Kconfig
```kconfig
menu "NOOP platform"

config SYS_MALLOC_F_LEN
	default 0x4000

config SYS_CONFIG_NAME
	string "configure name"
	default "noop"

config SYS_TEXT_BASE
	hex "Text base of u-boot"
	default 0xbfc00000

config SYS_SDRAM_BASE
	hex "base addr of sdram"
	default 0x80000000

config SYS_SDRAM_SIZE
	hex "size of sdram"
	default 0x8000000

endmenu
```
